## main/Kconfig.projbuild
```kconfig
menu "Patio weather display"

config PATIO_FIXTURE_MODE
    bool "Development fixture mode"
    default n
    help
        Render a deterministic fixture through the production models and UI.
        This is visibly marked and must remain disabled for live deployment.

config PATIO_FIXTURE_NAME
    string "Fixture name"
    default "baseline"
    depends on PATIO_FIXTURE_MODE
    help
        baseline, rain-passed, before-six, midnight, labour-day, halloween,
        ordinary-dry, heavy-rain, strong-wind, ice, snow, thunderstorm, heat,
        cold, poor-air-quality, high-uv, weather-unavailable,
        negative-temperature, extreme-precipitation, missing-values,
        aqhi-10-plus, stale-air-quality, stale-weather, multiple-alerts,
        long-text, alert-feed-failure, unsupported-coverage, minimal-rain,
        sunny-uv, cloudy-holiday, snow-wind, or storm-danger.

config PATIO_HTTP_USER_AGENT
    string "Identifying HTTP User-Agent"
    default "PatioWeatherDisplay/1.0 (personal ESP32 weather display)"
    help
        Nominatim forbids stock User-Agents. Set this to an identifying product
        name and contact URL/email before using its public service.

config PATIO_WEATHER_REFRESH_SECONDS
    int "Weather refresh interval"
    range 600 3600
    default 900
    help
        Regular interval for successful weather polling. Temporary connection
        failures retry at 30, 60, 120 and then 300 seconds while online.
        Provider Retry-After limits are honored.

config PATIO_AQHI_REFRESH_SECONDS
    int "AQHI refresh interval"
    range 600 3600
    default 900

config PATIO_ALERT_REFRESH_SECONDS
    int "Official-alert refresh interval"
    range 300 3600
    default 300

config PATIO_WEATHER_STALE_SECONDS
    int "Weather source-age stale threshold"
    range 3600 43200
    default 10800

config PATIO_AQHI_STALE_SECONDS
    int "AQHI observation-age stale threshold"
    range 3600 21600
    default 7200

endmenu
```
